## Kconfig
```kconfig
menuconfig AVIRT
        tristate "AVIRT support"
        default n
        ---help---
	  Say Y here if you want to enable AVIRT support.
	  This driver needs at least one additional audio path in
	  order to establish audio routing.

	  To compile this driver as a module, choose M here: the
	  module will be called avirt_core.

          If in doubt, say N here.



if AVIRT

source "drivers/staging/avirt/dummy/Kconfig"
source "drivers/staging/avirt/loopback/Kconfig"

endif
```

## dummy/Kconfig
```kconfig
#
# AVIRT Dummy Audio Path
#

config AVIRT_DUMMYAP
	tristate "DummyAP"
	select SND_PCM
	---help---
	  Say Y here if you want to add dummy audio path.

	  To compile this driver as a module, choose M here: the
	  module will be called avirt_dummyap.
```

## loopback/Kconfig
```kconfig
#
# AVIRT Loopback Audio Path
#

config AVIRT_LOOPBACKAP
	tristate "LoopbackAP"
	select SND_PCM
	---help---
	  Say Y here if you want to add loopback audio path.

	  To compile this driver as a module, choose M here: the
	  module will be called avirt_loopbackap.
```
